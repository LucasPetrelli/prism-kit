## CMakeLists.txt
```
cmake_minimum_required(VERSION 3.20.0)

# OSHAL owns the Zephyr-specific Devicetree bindings. Register that root before
# Zephyr configures its Devicetree search paths; non-Zephyr OSHAL backends do
# not consume this application CMake file.
set(DTS_ROOT "${CMAKE_CURRENT_SOURCE_DIR}/oshal" ${DTS_ROOT})

# Zephyr remains the build owner. This repository contributes sources,
# configuration, and documentation on top of the standard Zephyr application
# model instead of creating a parallel bare-metal build flow.
find_package(Zephyr REQUIRED HINTS $ENV{ZEPHYR_BASE})
project(prism_kit)

# Keep the Zephyr-facing integration thin and compose the firmware from
# explicit layers. The Zephyr main() entry point resides in the OSHAL layer,
# while the root app target owns only the thin composition glue that wires APP
# and BAL into the OSHAL-owned handoff hook.

foreach(required_submodule IN ITEMS oshal bal)
	if(NOT EXISTS "${CMAKE_CURRENT_SOURCE_DIR}/${required_submodule}/CMakeLists.txt")
		message(FATAL_ERROR
			"Required submodule '${required_submodule}' is missing or not initialized. "
			"Run 'git submodule update --init --recursive' from the repository root and retry.")
	endif()
endforeach()

add_subdirectory(oshal)

if(OSHAL_DEMO STREQUAL "none")
	target_sources(app PRIVATE src/boot_handoff_zephyr.cpp)
	add_subdirectory(bal)
	add_subdirectory(protocol)
	add_subdirectory(app)
else()
	target_link_libraries(app PRIVATE oshal_implementation)
endif()
```

## west.yml
```
manifest:
  version: "0.13"

  remotes:
    # Pull Zephyr and imported modules from the canonical upstream source so
    # the workspace can be recreated deterministically on a fresh machine.
    - name: zephyrproject-rtos
      url-base: https://github.com/zephyrproject-rtos

  projects:
    # Pin Zephyr to a real release tag so the repo evolves against a known API
    # surface instead of tracking upstream main implicitly.
    - name: zephyr
      remote: zephyrproject-rtos
      revision: v4.3.0
      # Import the upstream Zephyr manifest as-is for compatibility first. The
      # repository's own source layout stays minimal even if the workspace pulls
      # in the broader Zephyr project set.
      import: true
```

## prj.conf
```kconfig
# GPIO is required for the phase-1 board LED smoke test and remains useful for
# later low-level timing bring-up work.
CONFIG_GPIO=y

# Keep a serial console available during early bring-up so failures in HAL or
# BAL are visible before the WS2812 path exists.
CONFIG_SERIAL=y
CONFIG_CONSOLE=y
CONFIG_UART_CONSOLE=y
CONFIG_STDOUT_CONSOLE=y
CONFIG_UART_LINE_CTRL=y

# Route the chosen console through the XIAO USB device controller so Zephyr
# logs and the OSHAL DebugPort share the primary CDC ACM transport while OSHAL
# owns composite registration for any additional CDC ACM channels.
CONFIG_USB_DEVICE_STACK_NEXT=y
# Runtime watermarks show about 400 bytes used by usbd; recheck this size under
# full USB traffic because it leaves about 112 bytes of observed headroom.
CONFIG_USBD_THREAD_STACK_SIZE=512
CONFIG_CDC_ACM_SERIAL_INITIALIZE_AT_BOOT=n

# Two CDC ACM instances share the UDC driver buffer pool by default on
# full-speed devices, which can starve the second instance of USB transfer
# buffers.  Use a dedicated pool sized for the number of instances so both
# COM ports can enqueue transfers concurrently.
CONFIG_USBD_CDC_ACM_BUF_POOL=y

# The GNU Arm Embedded toolchain available on this host provides newlib rather
# than Zephyr SDK picolibc integration, so select the matching libc explicitly.
CONFIG_NEWLIB_LIBC=y
# This firmware does not currently use dynamic allocation, so keep newlib's
# required heap floor small enough to preserve SRAM headroom during bring-up.
CONFIG_NEWLIB_LIBC_MIN_REQUIRED_HEAP_SIZE=1024

# A console-backed printk path is enough for the thin Zephyr-owned startup
# error path, and avoiding the deferred logging thread saves a meaningful chunk
# of SRAM on the SAMD21.
CONFIG_PRINTK=y
CONFIG_LOG=n

# APP is migrated first to C++. Zephyr still owns startup, while the current
# firmware stays on a conservative C++17 dialect that is broadly supported by
# embedded toolchains.
CONFIG_CPP=y
CONFIG_STD_CPP17=y
CONFIG_GLIBCXX_LIBCPP=y
CONFIG_CPP_EXCEPTIONS=n

# Assertions are cheap insurance during early architecture work where the goal
# is to validate layer boundaries before optimizing anything.
CONFIG_ASSERT=y

# Task runtime diagnostics need Zephyr to retain thread runtime counters and
# initialize stack memory so OSHAL can report CPU load samples plus stack
# watermark information for each task.
CONFIG_THREAD_RUNTIME_STATS=y
CONFIG_THREAD_STACK_INFO=y
CONFIG_INIT_STACKS=y
CONFIG_THREAD_MONITOR=y
CONFIG_THREAD_NAME=y
CONFIG_THREAD_MAX_NAME_LEN=24
```

## prj.debug.conf
```kconfig
CONFIG_DEBUG=y
CONFIG_DEBUG_OPTIMIZATIONS=y
```

## prj.noopt.conf
```kconfig
CONFIG_DEBUG=y
CONFIG_NO_OPTIMIZATIONS=y
```

## boards/xiao_ble_nrf52840_sense.conf
```kconfig
# Enable the Zephyr SPI-backed WS2812 transport for the normal Sense image.
CONFIG_SPI=y
CONFIG_LED_STRIP=y
CONFIG_WS2812_STRIP_SPI=y
```

## boards/seeeduino_xiao.overlay
```dts
#include "../bal/boards/seeeduino_xiao.overlay"
```

## boards/xiao_ble_nrf52840_sense.overlay
```dts
#include "../bal/boards/xiao_nrf52_sense.overlay"
```

## src/main.c
```c
#include <zephyr/logging/log.h>

#include "bal/bootstrap.h"

LOG_MODULE_REGISTER(main, CONFIG_LOG_DEFAULT_LEVEL);

int main(void)
{
	int ret;

	/*
	 * Keep Zephyr's root entry point in C and thin. BAL owns the next stage and
	 * can bridge into C++ application code without pulling Zephyr concerns upward.
	 */
	ret = bal_bootstrap_run();
	if (ret < 0) {
		LOG_ERR("BAL bootstrap failed: %d", ret);
		return ret;
	}

	return 0;
}
```

## src/boot_handoff_zephyr.c
```c
#include "app/app.h"
#include "bal/bootstrap.h"

int oshal_main_handoff(void)
{
	return bal_run(app_run);
}
```

## src/boot_handoff_zephyr.cpp
```c
#include <zephyr/kernel/thread_stack.h>

#include <cstddef>

#include "app/app.hpp"
#include "bal/bootstrap.hpp"
#include "hw/hw_constants.hpp"

namespace {

constexpr std::size_t kAppTaskStackSizeBytes = 1536U;
K_THREAD_STACK_DEFINE(g_app_task_stack, kAppTaskStackSizeBytes);
K_THREAD_STACK_DEFINE(g_hw_task_stack, app::hw::kTaskStackSizeBytes);
app::AppTaskStartupContext g_app_task_startup_context{
  g_hw_task_stack, K_THREAD_STACK_SIZEOF(g_hw_task_stack)};

}  // namespace

// NOLINTNEXTLINE(readability-identifier-naming)
extern "C" int oshal_main_handoff(void) {
  return bal::RunBootstrap(app::AppTask::SetupTrampoline,
                           app::AppTask::LoopTrampoline, g_app_task_stack,
                           K_THREAD_STACK_SIZEOF(g_app_task_stack),
                           &g_app_task_startup_context);
}
```
